## build/conf/local.conf
```bitbake
# Machine Selection used as default
MACHINE ??= "raspberrypi5"

# The distribution setting controls which policy settings are used as defaults
DISTRO ?= "poky-tinyos"

# Package Management configuration
PACKAGE_CLASSES ?= "package_ipk"

# Enable opkg package managment features 
IMAGE_FEATURES += "package-management"

# Set package managment url
# PACKAGE_FEED_URIS = "http://huxley.tinyosx.com"
PACKAGE_FEED_BASE_PATHS = "ipk"

# Set host name for using the PR service
# PRSERV_HOST = "localhost:0"
# PRSERV_HOST = "huxley:8585" 

# Interactive shell configuration
PATCHRESOLVE = "noop"

# Activate build history for the PR service
INHERIT += "buildhistory"
BUILDHISTORY_COMMIT = "1"
BUILDHISTORY_FEATURES = "image package"

# Additional image features
USER_CLASSES ?= "buildstats"

# Removes work files after the openembedded build system has finished.
INHERIT += "rm_work"

# Use upstream shared state cache mirror after looking in SSTATE_DIR
SSTATE_MIRRORS ?= "file://.* http://cdn.jsdelivr.net/yocto/sstate/all/PATH;downloadfilename=PATH"
BB_SIGNATURE_HANDLER = "OEEquivHash"
BB_HASHSERVE = "auto"
BB_HASHSERVE_UPSTREAM = "hashserv.yocto.io:8687"

# IP Compliance - WiFi/BT firmware
LICENSE_FLAGS_ACCEPTED = "synaptics-killswitch"

# Disk Space Monitoring during the build
BB_DISKMON_DIRS ??= "\
    STOPTASKS,${TMPDIR},1G,100K \
    STOPTASKS,${DL_DIR},1G,100K \
    STOPTASKS,${SSTATE_DIR},1G,100K \
    STOPTASKS,/tmp,100M,100K \
    HALT,${TMPDIR},100M,1K \
    HALT,${DL_DIR},100M,1K \
    HALT,${SSTATE_DIR},100M,1K \
    HALT,/tmp,10M,1K"

# Configuration version
CONF_VERSION = "2"
```
